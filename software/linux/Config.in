## software/linux/Config.in
```kconfig
config BR2_PACKAGE_ZCORE_APPS
	bool "Z-Core Linux applications and benchmarks"
	default y

config BR2_PACKAGE_ZCORE_HTOP
	bool "htop (static no-MMU port)"
	select BR2_PACKAGE_NCURSES
	default y

config BR2_PACKAGE_ZCORE_LSCPU
	bool "util-linux lscpu (static no-MMU port)"
	default y

config BR2_PACKAGE_ZCORE_VIM
	bool "Vim tiny (no-MMU port)"
	select BR2_PACKAGE_NCURSES
	default y
```

## software/linux/configs/zcore_defconfig
```kconfig
BR2_riscv=y
BR2_riscv_custom=y
BR2_RISCV_32=y
BR2_RISCV_ISA_RVM=y
BR2_RISCV_ISA_RVA=y
# BR2_RISCV_ISA_RVF is not set
# BR2_RISCV_ISA_RVD is not set
# BR2_RISCV_ISA_RVC is not set
# BR2_RISCV_USE_MMU is not set
BR2_RISCV_ABI_ILP32=y
BR2_BINFMT_FLAT=y
BR2_TOOLCHAIN_BUILDROOT_WCHAR=y
BR2_PACKAGE_NANO=y
BR2_PACKAGE_NANO_TINY=y
BR2_PACKAGE_ZCORE_VIM=y
BR2_PACKAGE_HOST_LINUX_HEADERS_CUSTOM_6_12=y
BR2_TARGET_GENERIC_HOSTNAME="zcore"
BR2_TARGET_GENERIC_ISSUE="Z-Core no-MMU Linux"
BR2_TARGET_GENERIC_GETTY_PORT="ttyZC0"
BR2_TARGET_GENERIC_GETTY_BAUDRATE_115200=y
BR2_ROOTFS_OVERLAY="$(BR2_EXTERNAL_ZCORE_PATH)/board/zcore/rootfs-overlay"
BR2_ROOTFS_POST_BUILD_SCRIPT="$(BR2_EXTERNAL_ZCORE_PATH)/scripts/finalize-rootfs.py"
BR2_PACKAGE_BUSYBOX_CONFIG_FRAGMENT_FILES="$(BR2_EXTERNAL_ZCORE_PATH)/configs/busybox.fragment"
BR2_PACKAGE_ZCORE_APPS=y
BR2_PACKAGE_ZCORE_HTOP=y
BR2_PACKAGE_ZCORE_LSCPU=y
BR2_LINUX_KERNEL=y
BR2_LINUX_KERNEL_CUSTOM_VERSION=y
BR2_LINUX_KERNEL_CUSTOM_VERSION_VALUE="6.12.10"
BR2_LINUX_KERNEL_USE_CUSTOM_CONFIG=y
BR2_LINUX_KERNEL_CUSTOM_CONFIG_FILE="$(BR2_EXTERNAL_ZCORE_PATH)/configs/linux.config"
BR2_TARGET_ROOTFS_INITRAMFS=y
# BR2_TARGET_ROOTFS_TAR is not set
```
